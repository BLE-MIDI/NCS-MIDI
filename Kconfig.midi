## lib/Kconfig
```kconfig
#
# Copyright (c) 2018 Nordic Semiconductor ASA
#
# SPDX-License-Identifier: LicenseRef-Nordic-5-Clause
#

menu "Libraries"

rsource "midi_parser/Kconfig"

endmenu
```

## subsys/bluetooth/Kconfig
```kconfig
#
# Copyright (c) 2018 Nordic Semiconductor
#
# SPDX-License-Identifier: LicenseRef-BSD-5-Clause-Nordic
#

menu "Bluetooth Low Energy"

if BT

comment "BLE Libraries"

rsource "services/Kconfig"

endif # BT

endmenu
```

## subsys/bluetooth/services/Kconfig
```kconfig
menu "Bluetooth Services"

rsource "Kconfig.midi_client"
rsource "Kconfig.midi"

endmenu
```

## subsys/bluetooth/services/Kconfig.midi
```kconfig
menuconfig BT_MIDI
	bool "MIDI service"
	select BT_NRF_SERVICES
	help
	  Enable MIDI service.
	  
if BT_MIDI

module = BT_MIDI
module-str = MIDI
source "${ZEPHYR_BASE}/subsys/logging/Kconfig.template.log_config"

endif # BT_MIDI
```

## subsys/bluetooth/services/Kconfig.midi_client
```kconfig
menuconfig BT_MIDI_CLIENT
	bool "MIDI service client"
	select BT_NRF_SERVICES
	help
	  Enable BLE GATT MIDI service client.

if BT_MIDI_CLIENT

module = BT_MIDI_CLIENT
module-str = MIDI Client
source "${ZEPHYR_BASE}/subsys/logging/Kconfig.template.log_config"

endif # BT_MIDI_CLIENT
```

## west.yml
```yaml
# The west manifest file for the NCS-MIDI project.
#
# The per-installation west configuration file specifies the location of this
# manifest file. The "path" option in the [manifest] section of .west/config
# defines the folder that contains west.yml. The path is relative to the folder
# that contains .west.
#

manifest:
  remotes:
      # nRF Connect SDK base URL.
    - name: ncs
      url-base: https://github.com/nrfconnect
  # The list of external projects for the nRF Connect SDK.
  #
  projects:
    - name: nrf
      remote: ncs
      repo-path: sdk-nrf
      revision: 8a1eb9b9fd51477f76d97deea126a5095de7de44
      import: true
  # Committed on Oct 15 

# West-related configuration for the nrf_midi_priv repository.
  self:
    path: nrf_midi
```
